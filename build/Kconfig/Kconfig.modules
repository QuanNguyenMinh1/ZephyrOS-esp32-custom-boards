## build/Kconfig/Kconfig.modules
```kconfig
menu "cmsis_6 (F:/Zephyr/Workspace/zephyrproject/deps/modules/hal/cmsis_6)"
osource "$(ZEPHYR_CMSIS_6_KCONFIG)"
config ZEPHYR_CMSIS_6_MODULE
	bool
	default y
endmenu
menu "hal_espressif (F:/Zephyr/Workspace/zephyrproject/deps/modules/hal/espressif)"
osource "F:/Zephyr/Workspace/zephyrproject/deps/modules/hal/espressif/zephyr/Kconfig"
config ZEPHYR_HAL_ESPRESSIF_MODULE
	bool
	default y
	select TAINT_BLOBS

config ZEPHYR_HAL_ESPRESSIF_MODULE_BLOBS
	bool
	default y
endmenu
config ZEPHYR_XTENSA_MODULE
	bool
	default y
menu "mbedtls (F:/Zephyr/Workspace/zephyrproject/deps/modules/crypto/mbedtls)"
osource "$(ZEPHYR_MBEDTLS_KCONFIG)"
config ZEPHYR_MBEDTLS_MODULE
	bool
	default y
endmenu
config ZEPHYR_MCUBOOT_MODULE
	bool
	default y
menu "percepio (F:/Zephyr/Workspace/zephyrproject/deps/modules/debug/percepio)"
osource "F:/Zephyr/Workspace/zephyrproject/deps/modules/debug/percepio/zephyr/Kconfig"
config ZEPHYR_PERCEPIO_MODULE
	bool
	default y
endmenu
menu "picolibc (F:/Zephyr/Workspace/zephyrproject/deps/modules/lib/picolibc)"
osource "F:/Zephyr/Workspace/zephyrproject/deps/modules/lib/picolibc/zephyr/Kconfig"
config ZEPHYR_PICOLIBC_MODULE
	bool
	default y
endmenu
menu "segger (F:/Zephyr/Workspace/zephyrproject/deps/modules/debug/segger)"
osource "$(ZEPHYR_SEGGER_KCONFIG)"
config ZEPHYR_SEGGER_MODULE
	bool
	default y
endmenu
config ZEPHYR_TF_PSA_CRYPTO_MODULE
	bool
	default y
menu "trusted-firmware-m (F:/Zephyr/Workspace/zephyrproject/deps/modules/tee/tf-m/trusted-firmware-m)"
osource "$(ZEPHYR_TRUSTED_FIRMWARE_M_KCONFIG)"
config ZEPHYR_TRUSTED_FIRMWARE_M_MODULE
	bool
	default y
endmenu
```

## build/Kconfig/arch/Kconfig
```kconfig
# Load Zephyr Arch Kconfig descriptions.
osource "F:/Zephyr/Workspace/zephyrproject/deps/zephyr/arch/rx/Kconfig"
osource "F:/Zephyr/Workspace/zephyrproject/deps/zephyr/arch/x86/Kconfig"
osource "F:/Zephyr/Workspace/zephyrproject/deps/zephyr/arch/xtensa/Kconfig"
osource "F:/Zephyr/Workspace/zephyrproject/deps/zephyr/arch/sparc/Kconfig"
osource "F:/Zephyr/Workspace/zephyrproject/deps/zephyr/arch/riscv/Kconfig"
osource "F:/Zephyr/Workspace/zephyrproject/deps/zephyr/arch/posix/Kconfig"
osource "F:/Zephyr/Workspace/zephyrproject/deps/zephyr/arch/openrisc/Kconfig"
osource "F:/Zephyr/Workspace/zephyrproject/deps/zephyr/arch/mips/Kconfig"
osource "F:/Zephyr/Workspace/zephyrproject/deps/zephyr/arch/arm64/Kconfig"
osource "F:/Zephyr/Workspace/zephyrproject/deps/zephyr/arch/arm/Kconfig"
osource "F:/Zephyr/Workspace/zephyrproject/deps/zephyr/arch/arc/Kconfig"
```

## build/Kconfig/boards/Kconfig.esp32_cam
```kconfig
# Load board Kconfig descriptions.
osource "F:/Zephyr/Workspace/zephyrproject/deps/zephyr/boards/aithinker/esp32_cam/Kconfig.esp32_cam"
```

## build/Kconfig/boards/Kconfig.sysbuild
```kconfig
# Load Sysbuild board Kconfig descriptions.
osource "F:/Zephyr/Workspace/zephyrproject/deps/zephyr/boards/aithinker/esp32_cam/Kconfig.sysbuild"
```

## build/Kconfig/soc/Kconfig
```kconfig
# Load Zephyr SoC Kconfig descriptions.
osource "F:/Zephyr/Workspace/zephyrproject/deps/zephyr/soc/xlnx/zynqmp/Kconfig"
osource "F:/Zephyr/Workspace/zephyrproject/deps/zephyr/soc/xlnx/zynq7000/Kconfig"
osource "F:/Zephyr/Workspace/zephyrproject/deps/zephyr/soc/xlnx/versalnet/Kconfig"
osource "F:/Zephyr/Workspace/zephyrproject/deps/zephyr/soc/xlnx/versal2/Kconfig"
osource "F:/Zephyr/Workspace/zephyrproject/deps/zephyr/soc/xlnx/versal/Kconfig"
osource "F:/Zephyr/Workspace/zephyrproject/deps/zephyr/soc/xen/Kconfig"
osource "F:/Zephyr/Workspace/zephyrproject/deps/zephyr/soc/wch/ch32v/Kconfig"
osource "F:/Zephyr/Workspace/zephyrproject/deps/zephyr/soc/ti/simplelink/Kconfig"
osource "F:/Zephyr/Workspace/zephyrproject/deps/zephyr/soc/ti/mspm/Kconfig"
osource "F:/Zephyr/Workspace/zephyrproject/deps/zephyr/soc/ti/lm3s6965/Kconfig"
osource "F:/Zephyr/Workspace/zephyrproject/deps/zephyr/soc/ti/k3/Kconfig"
osource "F:/Zephyr/Workspace/zephyrproject/deps/zephyr/soc/ti/am13/Kconfig"
osource "F:/Zephyr/Workspace/zephyrproject/deps/zephyr/soc/telink/tlsr/Kconfig"
osource "F:/Zephyr/Workspace/zephyrproject/deps/zephyr/soc/syna/sr100/Kconfig"
osource "F:/Zephyr/Workspace/zephyrproject/deps/zephyr/soc/starfive/jh71xx/Kconfig"
osource "F:/Zephyr/Workspace/zephyrproject/deps/zephyr/soc/st/stm32/Kconfig"
osource "F:/Zephyr/Workspace/zephyrproject/deps/zephyr/soc/snps/qemu_arc/Kconfig"
osource "F:/Zephyr/Workspace/zephyrproject/deps/zephyr/soc/snps/nsim/arc_v/Kconfig"
osource "F:/Zephyr/Workspace/zephyrproject/deps/zephyr/soc/snps/nsim/arc_classic/Kconfig"
osource "F:/Zephyr/Workspace/zephyrproject/deps/zephyr/soc/snps/hsdk4xd/Kconfig"
osource "F:/Zephyr/Workspace/zephyrproject/deps/zephyr/soc/snps/hsdk/Kconfig"
osource "F:/Zephyr/Workspace/zephyrproject/deps/zephyr/soc/snps/emsk/Kconfig"
osource "F:/Zephyr/Workspace/zephyrproject/deps/zephyr/soc/snps/emsdp/Kconfig"
osource "F:/Zephyr/Workspace/zephyrproject/deps/zephyr/soc/snps/arc_iot/Kconfig"
osource "F:/Zephyr/Workspace/zephyrproject/deps/zephyr/soc/silabs/Kconfig"
osource "F:/Zephyr/Workspace/zephyrproject/deps/zephyr/soc/sifli/sf32/Kconfig"
osource "F:/Zephyr/Workspace/zephyrproject/deps/zephyr/soc/sifive/sifive_freedom/Kconfig"
osource "F:/Zephyr/Workspace/zephyrproject/deps/zephyr/soc/shakti/Kconfig"
osource "F:/Zephyr/Workspace/zephyrproject/deps/zephyr/soc/sensry/Kconfig"
osource "F:/Zephyr/Workspace/zephyrproject/deps/zephyr/soc/rockchip/Kconfig"
osource "F:/Zephyr/Workspace/zephyrproject/deps/zephyr/soc/renode/riscv_virtual/Kconfig"
osource "F:/Zephyr/Workspace/zephyrproject/deps/zephyr/soc/renode/cortex_r8_virtual/Kconfig"
osource "F:/Zephyr/Workspace/zephyrproject/deps/zephyr/soc/renesas/smartbond/Kconfig"
osource "F:/Zephyr/Workspace/zephyrproject/deps/zephyr/soc/renesas/rz/Kconfig"
osource "F:/Zephyr/Workspace/zephyrproject/deps/zephyr/soc/renesas/rx/Kconfig"
osource "F:/Zephyr/Workspace/zephyrproject/deps/zephyr/soc/renesas/rcar/Kconfig"
osource "F:/Zephyr/Workspace/zephyrproject/deps/zephyr/soc/renesas/ra/Kconfig"
osource "F:/Zephyr/Workspace/zephyrproject/deps/zephyr/soc/realtek/fingerprint/Kconfig"
osource "F:/Zephyr/Workspace/zephyrproject/deps/zephyr/soc/realtek/ec/Kconfig"
osource "F:/Zephyr/Workspace/zephyrproject/deps/zephyr/soc/realtek/bee/Kconfig"
osource "F:/Zephyr/Workspace/zephyrproject/deps/zephyr/soc/realtek/ameba/Kconfig"
osource "F:/Zephyr/Workspace/zephyrproject/deps/zephyr/soc/raspberrypi/rpi_pico/Kconfig"
osource "F:/Zephyr/Workspace/zephyrproject/deps/zephyr/soc/quicklogic/eos_s3/Kconfig"
osource "F:/Zephyr/Workspace/zephyrproject/deps/zephyr/soc/qemu/virt_riscv/Kconfig"
osource "F:/Zephyr/Workspace/zephyrproject/deps/zephyr/soc/qemu/or1k/Kconfig"
osource "F:/Zephyr/Workspace/zephyrproject/deps/zephyr/soc/qemu/malta/Kconfig"
osource "F:/Zephyr/Workspace/zephyrproject/deps/zephyr/soc/openisa/rv32m1/Kconfig"
osource "F:/Zephyr/Workspace/zephyrproject/deps/zephyr/soc/openhwgroup/cva6/Kconfig"
osource "F:/Zephyr/Workspace/zephyrproject/deps/zephyr/soc/oct/osd32mp15x/Kconfig"
osource "F:/Zephyr/Workspace/zephyrproject/deps/zephyr/soc/nxp/s32/Kconfig"
osource "F:/Zephyr/Workspace/zephyrproject/deps/zephyr/soc/nxp/rw/Kconfig"
osource "F:/Zephyr/Workspace/zephyrproject/deps/zephyr/soc/nxp/mcx/Kconfig"
osource "F:/Zephyr/Workspace/zephyrproject/deps/zephyr/soc/nxp/lpc/Kconfig"
osource "F:/Zephyr/Workspace/zephyrproject/deps/zephyr/soc/nxp/layerscape/Kconfig"
osource "F:/Zephyr/Workspace/zephyrproject/deps/zephyr/soc/nxp/kinetis/Kconfig"
osource "F:/Zephyr/Workspace/zephyrproject/deps/zephyr/soc/nxp/imxrt/Kconfig"
osource "F:/Zephyr/Workspace/zephyrproject/deps/zephyr/soc/nxp/imx/Kconfig"
osource "F:/Zephyr/Workspace/zephyrproject/deps/zephyr/soc/nuvoton/numicro/Kconfig"
osource "F:/Zephyr/Workspace/zephyrproject/deps/zephyr/soc/nuvoton/numaker/Kconfig"
osource "F:/Zephyr/Workspace/zephyrproject/deps/zephyr/soc/nuvoton/npcx/Kconfig"
osource "F:/Zephyr/Workspace/zephyrproject/deps/zephyr/soc/nuvoton/npcm/Kconfig"
osource "F:/Zephyr/Workspace/zephyrproject/deps/zephyr/soc/nordic/Kconfig"
osource "F:/Zephyr/Workspace/zephyrproject/deps/zephyr/soc/neorv32/Kconfig"
osource "F:/Zephyr/Workspace/zephyrproject/deps/zephyr/soc/native/inf_clock/Kconfig"
osource "F:/Zephyr/Workspace/zephyrproject/deps/zephyr/soc/microchip/smartfusion2/Kconfig"
osource "F:/Zephyr/Workspace/zephyrproject/deps/zephyr/soc/microchip/sam/sama7/Kconfig"
osource "F:/Zephyr/Workspace/zephyrproject/deps/zephyr/soc/microchip/sam/sam_d5x_e5x/Kconfig"
osource "F:/Zephyr/Workspace/zephyrproject/deps/zephyr/soc/microchip/pic64/Kconfig"
osource "F:/Zephyr/Workspace/zephyrproject/deps/zephyr/soc/microchip/pic32c/pic32cz_ca/Kconfig"
osource "F:/Zephyr/Workspace/zephyrproject/deps/zephyr/soc/microchip/pic32c/pic32cx_sg/Kconfig"
osource "F:/Zephyr/Workspace/zephyrproject/deps/zephyr/soc/microchip/pic32c/pic32cm_sg_gc/Kconfig"
osource "F:/Zephyr/Workspace/zephyrproject/deps/zephyr/soc/microchip/pic32c/pic32cm_pl/Kconfig"
osource "F:/Zephyr/Workspace/zephyrproject/deps/zephyr/soc/microchip/pic32c/pic32cm_jh/Kconfig"
osource "F:/Zephyr/Workspace/zephyrproject/deps/zephyr/soc/microchip/pic32c/pic32ck_sg_gc/Kconfig"
osource "F:/Zephyr/Workspace/zephyrproject/deps/zephyr/soc/microchip/miv/Kconfig"
osource "F:/Zephyr/Workspace/zephyrproject/deps/zephyr/soc/microchip/mec/Kconfig"
osource "F:/Zephyr/Workspace/zephyrproject/deps/zephyr/soc/mediatek/mt8xxx/Kconfig"
osource "F:/Zephyr/Workspace/zephyrproject/deps/zephyr/soc/lowrisc/opentitan/Kconfig"
osource "F:/Zephyr/Workspace/zephyrproject/deps/zephyr/soc/litex/Kconfig"
osource "F:/Zephyr/Workspace/zephyrproject/deps/zephyr/soc/ite/ec/Kconfig"
osource "F:/Zephyr/Workspace/zephyrproject/deps/zephyr/soc/intel/wildcat_lake/Kconfig"
osource "F:/Zephyr/Workspace/zephyrproject/deps/zephyr/soc/intel/raptor_lake/Kconfig"
osource "F:/Zephyr/Workspace/zephyrproject/deps/zephyr/soc/intel/panther_lake/Kconfig"
osource "F:/Zephyr/Workspace/zephyrproject/deps/zephyr/soc/intel/nova_lake/Kconfig"
osource "F:/Zephyr/Workspace/zephyrproject/deps/zephyr/soc/intel/lakemont/Kconfig"
osource "F:/Zephyr/Workspace/zephyrproject/deps/zephyr/soc/intel/intel_socfpga_std/Kconfig"
osource "F:/Zephyr/Workspace/zephyrproject/deps/zephyr/soc/intel/intel_socfpga/Kconfig"
osource "F:/Zephyr/Workspace/zephyrproject/deps/zephyr/soc/intel/intel_niosv/Kconfig"
osource "F:/Zephyr/Workspace/zephyrproject/deps/zephyr/soc/intel/intel_ish/Kconfig"
osource "F:/Zephyr/Workspace/zephyrproject/deps/zephyr/soc/intel/intel_adsp/Kconfig"
osource "F:/Zephyr/Workspace/zephyrproject/deps/zephyr/soc/intel/elkhart_lake/Kconfig"
osource "F:/Zephyr/Workspace/zephyrproject/deps/zephyr/soc/intel/atom/Kconfig"
osource "F:/Zephyr/Workspace/zephyrproject/deps/zephyr/soc/intel/apollo_lake/Kconfig"
osource "F:/Zephyr/Workspace/zephyrproject/deps/zephyr/soc/intel/alder_lake/Kconfig"
osource "F:/Zephyr/Workspace/zephyrproject/deps/zephyr/soc/infineon/psoc4/Kconfig"
osource "F:/Zephyr/Workspace/zephyrproject/deps/zephyr/soc/infineon/edge/Kconfig"
osource "F:/Zephyr/Workspace/zephyrproject/deps/zephyr/soc/infineon/cat3/Kconfig"
osource "F:/Zephyr/Workspace/zephyrproject/deps/zephyr/soc/infineon/cat1c/Kconfig"
osource "F:/Zephyr/Workspace/zephyrproject/deps/zephyr/soc/infineon/cat1b/Kconfig"
osource "F:/Zephyr/Workspace/zephyrproject/deps/zephyr/soc/infineon/cat1a/Kconfig"
osource "F:/Zephyr/Workspace/zephyrproject/deps/zephyr/soc/gd/gd32/Kconfig"
osource "F:/Zephyr/Workspace/zephyrproject/deps/zephyr/soc/gaisler/leon3/Kconfig"
osource "F:/Zephyr/Workspace/zephyrproject/deps/zephyr/soc/gaisler/gr716a/Kconfig"
osource "F:/Zephyr/Workspace/zephyrproject/deps/zephyr/soc/focaltech/Kconfig"
osource "F:/Zephyr/Workspace/zephyrproject/deps/zephyr/soc/espressif/Kconfig"
osource "F:/Zephyr/Workspace/zephyrproject/deps/zephyr/soc/ene/kb1200/Kconfig"
osource "F:/Zephyr/Workspace/zephyrproject/deps/zephyr/soc/ene/kb106x/Kconfig"
osource "F:/Zephyr/Workspace/zephyrproject/deps/zephyr/soc/elan/em32f967/Kconfig"
osource "F:/Zephyr/Workspace/zephyrproject/deps/zephyr/soc/egis/Kconfig"
osource "F:/Zephyr/Workspace/zephyrproject/deps/zephyr/soc/efinix/sapphire/Kconfig"
osource "F:/Zephyr/Workspace/zephyrproject/deps/zephyr/soc/cdns/xtensa_sample_controller/Kconfig"
osource "F:/Zephyr/Workspace/zephyrproject/deps/zephyr/soc/cdns/swerv/Kconfig"
osource "F:/Zephyr/Workspace/zephyrproject/deps/zephyr/soc/cdns/sample_controller32/Kconfig"
osource "F:/Zephyr/Workspace/zephyrproject/deps/zephyr/soc/cdns/dc233c/Kconfig"
osource "F:/Zephyr/Workspace/zephyrproject/deps/zephyr/soc/brcm/bcmvk/Kconfig"
osource "F:/Zephyr/Workspace/zephyrproject/deps/zephyr/soc/brcm/bcm2712/Kconfig"
osource "F:/Zephyr/Workspace/zephyrproject/deps/zephyr/soc/brcm/bcm2711/Kconfig"
osource "F:/Zephyr/Workspace/zephyrproject/deps/zephyr/soc/blackberry/qnxhv_vm/Kconfig"
osource "F:/Zephyr/Workspace/zephyrproject/deps/zephyr/soc/bflb/Kconfig"
osource "F:/Zephyr/Workspace/zephyrproject/deps/zephyr/soc/atmel/sam0/Kconfig"
osource "F:/Zephyr/Workspace/zephyrproject/deps/zephyr/soc/atmel/sam/Kconfig"
osource "F:/Zephyr/Workspace/zephyrproject/deps/zephyr/soc/aspeed/Kconfig"
osource "F:/Zephyr/Workspace/zephyrproject/deps/zephyr/soc/arm/Kconfig"
osource "F:/Zephyr/Workspace/zephyrproject/deps/zephyr/soc/arm/beetle/Kconfig"
osource "F:/Zephyr/Workspace/zephyrproject/deps/zephyr/soc/antmicro/myra/Kconfig"
osource "F:/Zephyr/Workspace/zephyrproject/deps/zephyr/soc/andestech/Kconfig"
osource "F:/Zephyr/Workspace/zephyrproject/deps/zephyr/soc/amd/acp_7_x/Kconfig"
osource "F:/Zephyr/Workspace/zephyrproject/deps/zephyr/soc/amd/acp_7_0/Kconfig"
osource "F:/Zephyr/Workspace/zephyrproject/deps/zephyr/soc/amd/acp_6_0/Kconfig"
osource "F:/Zephyr/Workspace/zephyrproject/deps/zephyr/soc/ambiq/Kconfig"
osource "F:/Zephyr/Workspace/zephyrproject/deps/zephyr/soc/allwinner/sun8i_h3/Kconfig"
osource "F:/Zephyr/Workspace/zephyrproject/deps/zephyr/soc/allwinner/sun50i_h618/Kconfig"
osource "F:/Zephyr/Workspace/zephyrproject/deps/zephyr/soc/alif/ensemble/Kconfig"
osource "F:/Zephyr/Workspace/zephyrproject/deps/zephyr/soc/alif/balletto/Kconfig"
osource "F:/Zephyr/Workspace/zephyrproject/deps/zephyr/soc/aesc/Kconfig"
osource "F:/Zephyr/Workspace/zephyrproject/deps/zephyr/soc/adi/max32/Kconfig"
```
