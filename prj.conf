## CMakeLists.txt
```
cmake_minimum_required(VERSION 3.20.0)

find_package(Zephyr REQUIRED HINTS $ENV{ZEPHYR_BASE})
project(Zephyr_Blinky_V2)

target_sources(app PRIVATE src/main.c)
```

## prj.conf
```kconfig
# General & Logging
CONFIG_LOG=y
```

## boards/esp32_cam_esp32_procpu.overlay
```dts
/ {
    aliases {
        led0 = &flash_led;
    };

    leds {
        compatible = "gpio-leds";
        flash_led: flash_led {
            gpios = <&gpio0 4 GPIO_ACTIVE_HIGH>; /* Flash LED nối gpio_4*/
            label = "Camera Flash LED";
        };
    };
};
```

## boards/esp32_devkitc_esp32_procpu.overlay
```dts
/ {
	aliases {
		led0 = &led_builtIn;
	};

	leds {
		compatible = "gpio-leds";
		led_builtIn: led_0 {
			gpios = <&gpio0 2 GPIO_ACTIVE_HIGH>;	// port0 quan ly gpio2
			label = "Onboard LED";
		};
	};
};
```

## boards/stm32_min_dev_stm32f103x8.overlay
```dts
/*
 * Copyright (c) 2017, embedjournal.com
 *
 * SPDX-License-Identifier: Apache-2.0
 */

/ {
	model = "STM32 Minimum Development Board (Blue)";
	compatible = "stm32_min_dev_blue", "st,stm32f103c8";

	leds {
		led0: led {
			gpios = <&gpioc 13 GPIO_ACTIVE_LOW>;
		};
	};
};
```

## src/main.c
```c
#include <zephyr/kernel.h>
#include <zephyr/drivers/gpio.h>

#define LED_builtIn DT_ALIAS(led0)

static const struct gpio_dt_spec led = GPIO_DT_SPEC_GET(LED_builtIn, gpios);

int gpio_init(void)
{
    int ret;
    // khoi tao gpio
	if (!gpio_is_ready_dt(&led)) {
		return 0;
	}
    // gpio - output
	ret = gpio_pin_configure_dt(&led, GPIO_OUTPUT_ACTIVE);
    // kiem tra loi
	if (ret < 0) {
		return 0;
	}
    
    return ret;
}

int main(void)
{
    int ret;
    bool led_state = 1;

    ret = gpio_init(); 

    while (1)
    {
        ret = gpio_pin_toggle_dt(&led);
		if (ret < 0) {
			return 0;
		}

		led_state = !led_state;
        k_msleep(5000);
    }
    return 0;
}
```
